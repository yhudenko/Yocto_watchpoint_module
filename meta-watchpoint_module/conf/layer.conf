## meta-watchpoint_module/conf/layer.conf
```bitbake
# We have a conf and classes directory, add to BBPATH
BBPATH .= ":${LAYERDIR}"

# We have recipes-* directories, add to BBFILES
BBFILES += "${LAYERDIR}/recipes-*/*/*.bb \
            ${LAYERDIR}/recipes-*/*/*.bbappend"

BBFILE_COLLECTIONS += "watchpoint_module"
BBFILE_PATTERN_watchpoint_module = "^${LAYERDIR}/"
BBFILE_PRIORITY_watchpoint_module = "6"

LAYERDEPENDS_watchpoint_module = "core"
LAYERSERIES_COMPAT_watchpoint_module = "dunfell"
```
